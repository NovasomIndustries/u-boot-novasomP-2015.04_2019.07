## board/novasomp/Kconfig
```kconfig
if TARGET_NOVASOMP

config SYS_BOARD
	default "novasomp"

config SYS_SOC
	default "mx6"

config SYS_CONFIG_NAME
	default "novasomp"

endif
```

## configs/novasomu_defconfig
```kconfig
CONFIG_SYS_EXTRA_OPTIONS="IMX_CONFIG=board/freescale/mx6ul_14x14_evk/imximage.cfg,MX6UL"
CONFIG_ARM=y
CONFIG_TARGET_NOVASOMU=y
CONFIG_DM=y
CONFIG_DM_THERMAL=y
```
